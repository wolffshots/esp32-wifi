## Kconfig.projbuild
```kconfig
# config vars for esp32-wifi
menu "wolffshots/esp32-wifi config"
    config ESP_ENABLE_WIFI
        bool "enable wifi"
        default y
        help
            enable or disable wifi config
    choice
        depends on ESP_ENABLE_WIFI
        prompt "station or soft ap"
        config ESP_ENABLE_WIFI_STA
            bool "station"
        config ESP_ENABLE_WIFI_SOFTAP
            bool "soft ap"
    endchoice
    if !ESP_ENABLE_WIFI_SOFTAP && ESP_ENABLE_WIFI_STA
        menu "station"
            config ESP_WIFI_SSID_STA
                string "wifi ssid"
                default "netWolff"
                help
                    ssid (network name) for the example to connect to.
            config ESP_WIFI_PASSWORD_STA
                string "wifi password"
                default "mypassword"
                help
                    wifi password (WPA or WPA2) for the example to use.
            config ESP_MAXIMUM_RETRY_STA
                int "maximum retries"
                default 5
                help
                    set the maximum retry to avoid station reconnecting to the ap unlimited when the ap is really inexistent
            config WIFI_STA_LOG_TAG
                string  "log tag for wifi sta"
                default "esp32-wifi_sta"
                help
                    the tag to use when using the esp logging library for station mode
        endmenu
    endif
    comment "station disabled"
        depends on !ESP_ENABLE_WIFI_STA
    if ESP_ENABLE_WIFI_SOFTAP && !ESP_ENABLE_WIFI_STA
        menu "soft ap"
            config ESP_WIFI_SSID_SOFTAP
                string "wifi ssid"
                default "esp-ssid"
                help
                    SSID (network name) for the example to connect to.
            config ESP_WIFI_PASSWORD_SOFTAP
                string "wifi password"
                default "mypassword"
                help
                    wifi password (WPA or WPA2) for the example to use.
            config ESP_WIFI_CHANNEL_SOFTAP
                int "wifi channel"
                range 1 13
                default 1
                help
                    wifi channel (network channel) for the example to use.
            config ESP_MAX_STA_CONN_SOFTAP
                int "maximal station connections"
                default 4
                help
                    max number of stations to connect to ap
            config WIFI_SAP_LOG_TAG
                string  "log tag for wifi sap"
                default "esp32-wifi_sap"
                help
                    the tag to use when using the esp logging library for softap mode
        endmenu
    endif
    comment "soft ap disabled"
        depends on !ESP_ENABLE_WIFI_SOFTAP
endmenu
```
